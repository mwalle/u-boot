## board/sipeed/m1sdock/Kconfig
```kconfig
# SPDX-License-Identifier: GPL-2.0+
# Copyright (C) 2023 Michael Walle <michael@walle.cc>

if TARGET_SIPEED_M1SDOCK

config SYS_BOARD
	default "m1sdock"

config SYS_VENDOR
	default "sipeed"

config SYS_CPU
	default "c906"

config SYS_CONFIG_NAME
	default "sipeed-m1sdock"

config TEXT_BASE
	default 0x80000000

config DEFAULT_DEVICE_TREE
	default "bl808-sipeed-m1s-dock"

config NR_CPUS
	default 1

config BOARD_SPECIFIC_OPTIONS
	def_bool y
	select GENERIC_RISCV
endif
```

## configs/sipeed_m1s_dock_defconfig
```kconfig
CONFIG_RISCV=y
CONFIG_TEXT_BASE=0x62030000
CONFIG_SYS_MALLOC_LEN=0x800000
CONFIG_SYS_MALLOC_F_LEN=0x800
CONFIG_NR_DRAM_BANKS=1
CONFIG_ENV_SIZE=0x20000
CONFIG_DEBUG_UART_BASE=0x2000a000
CONFIG_DEBUG_UART_CLOCK=800000
CONFIG_SYS_LOAD_ADDR=0x62020000
CONFIG_DEBUG_UART=y
CONFIG_TARGET_SIPEED_M1SDOCK=y
CONFIG_OF_BOARD_FIXUP=y
CONFIG_ENV_VARS_UBOOT_CONFIG=y
CONFIG_HAS_CUSTOM_SYS_INIT_SP_ADDR=y
CONFIG_CUSTOM_SYS_INIT_SP_ADDR=0x6202fff0
# CONFIG_BOOTSTD is not set
# CONFIG_LEGACY_IMAGE_FORMAT is not set
# CONFIG_ARCH_FIXUP_FDT_MEMORY is not set
# CONFIG_AUTOBOOT is not set
CONFIG_DEFAULT_FDT_FILE="sifive/hifive-unmatched-a00.dtb"
CONFIG_DISPLAY_CPUINFO=y
CONFIG_DISPLAY_BOARDINFO=y
CONFIG_DISPLAY_BOARDINFO_LATE=y
CONFIG_EVENT=y
CONFIG_EVENT_DYNAMIC=y
# CONFIG_CMDLINE is not set
CONFIG_SYS_CBSIZE=256
CONFIG_SYS_PBSIZE=276
# CONFIG_CMD_BDI is not set
# CONFIG_CMD_CONSOLE is not set
# CONFIG_CMD_BOOTD is not set
# CONFIG_CMD_BOOTM is not set
# CONFIG_CMD_BOOTI is not set
# CONFIG_CMD_ELF is not set
# CONFIG_CMD_FDT is not set
# CONFIG_CMD_GO is not set
# CONFIG_CMD_RUN is not set
# CONFIG_CMD_IMI is not set
# CONFIG_CMD_XIMG is not set
# CONFIG_CMD_EXPORTENV is not set
# CONFIG_CMD_IMPORTENV is not set
# CONFIG_CMD_EDITENV is not set
# CONFIG_CMD_SAVEENV is not set
# CONFIG_CMD_ENV_EXISTS is not set
# CONFIG_CMD_CRC32 is not set
# CONFIG_CMD_MEMORY is not set
# CONFIG_CMD_DM is not set
# CONFIG_CMD_LOADB is not set
# CONFIG_CMD_LOADS is not set
# CONFIG_CMD_ECHO is not set
# CONFIG_CMD_ITEST is not set
# CONFIG_CMD_SOURCE is not set
# CONFIG_CMD_SETEXPR is not set
# CONFIG_CMD_SLEEP is not set
CONFIG_EFI_PARTITION=y
# CONFIG_NET is not set
# CONFIG_BLOCK_CACHE is not set
# CONFIG_CLK is not set
# CONFIG_GPIO is not set
# CONFIG_I2C is not set
# CONFIG_INPUT is not set
# CONFIG_DM_MMC is not set
# CONFIG_MTD is not set
# CONFIG_POWER is not set
CONFIG_DEBUG_UART_ANNOUNCE=y
CONFIG_DEBUG_UART_SKIP_INIT=y
CONFIG_BFLB_SERIAL=y
CONFIG_RISCV_TIMER=y
CONFIG_SHA1=y
CONFIG_SHA256=y
CONFIG_MD5=y
CONFIG_LZ4=y
CONFIG_LZMA=y
# CONFIG_EFI_LOADER is not set
# CONFIG_LMB is not set
```

## drivers/ram/bflb/Kconfig
```kconfig
config RAM_BFLB
	bool "Ram drivers support for Bouffalolab SoCs"
	depends on RAM && RISCV
	default y
	help
	  This enables support for ram drivers of Bouffalolab SoCs.

config BFLB_PSRAM
	bool "Bouffalolab PSRAM driver"
	depends on RAM_BFLB
	default y if TARGET_SIPEED_M1SDOCK
	help
	  This enables PSRAM support for the platforms based on Bouffalolab SoC.
```
